## dts/bindings/gpio/nordic,gpio-pins.yaml
```yaml
# Copyright (c) 2023 Nordic Semiconductor ASA
# SPDX-License-Identifier: LicenseRef-Nordic-5-Clause

description: |
  This binding allows to define the pin of the GPIO to be owned by the domain.
  It does not provide any specific driver.
  It enables the following functionalities:

  - Generate the right UICR marking the domain to own the selected pin.
  - Access to pins by the macros from the `zephyr/devicetree/gpio.h` file,
    which increases the hardware abstraction.

compatible: "nordic,gpio-pins"

properties:
  gpios:
    type: phandle-array
    required: true
```
